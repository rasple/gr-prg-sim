ASAP2_VERSION 1 41
/begin PROJECT systemTest_PC "Generated by ETAS from Project systemTest_PC"
/begin HEADER "" VERSION "000" PROJECT_NO ASD /end HEADER
/begin MODULE systemTest_PC "Generated by ETAS ASCET7 from Project: systemTest_PC"
/begin IF_DATA E_TARGET
 /begin SOURCE "Task0" 3 /* period */ 10 QP_BLOB 1 /end SOURCE
 /begin TP_BLOB /* programm id */ 3816849659 /* target id */ 7 0 2 0 /end TP_BLOB
/end IF_DATA
/begin MOD_PAR "" VERSION "000" ADDR_EPK 0x0 EPK "" SUPPLIER "ETAS GmbH" CUSTOMER "xxx" CUSTOMER_NO "000" USER "xxx" PHONE_NO "000" ECU "PC" CPU_TYPE "PCx86" NO_OF_INTERFACES 1 /end MOD_PAR
/begin MOD_COMMON "Common definitions" BYTE_ORDER MSB_LAST ALIGNMENT_BYTE 1 ALIGNMENT_WORD 2 ALIGNMENT_LONG 4 ALIGNMENT_FLOAT32_IEEE 4 ALIGNMENT_FLOAT64_IEEE 8 /end MOD_COMMON
/begin MEASUREMENT components.systemTest.t "" FLOAT32_IEEE esdl_ident 1 100.0 -3.4028234663852886E+38 3.4028234663852886E+38 ECU_ADDRESS 0x4340CC /end MEASUREMENT
/begin MEASUREMENT components.systemTest.faktor "" FLOAT32_IEEE esdl_ident 1 100.0 -3.4028234663852886E+38 3.4028234663852886E+38 ECU_ADDRESS 0x4340C4 /end MEASUREMENT
/begin MEASUREMENT components.systemTest.dropPressure "" UBYTE esdl_ident 1 100.0 0 1 ECU_ADDRESS 0x4340D1 BIT_MASK 0x1 /end MEASUREMENT
/begin MEASUREMENT components.systemTest.sound "" UBYTE esdl_ident 1 100.0 0 1 ECU_ADDRESS 0x4340D2 BIT_MASK 0x1 /end MEASUREMENT
/begin MEASUREMENT components.systemTest.random "" FLOAT32_IEEE esdl_ident 1 100.0 -3.4028234663852886E+38 3.4028234663852886E+38 ECU_ADDRESS 0x4340C8 /end MEASUREMENT
/begin MEASUREMENT components.systemTest.dt_ "" FLOAT32_IEEE esdl_ident 1 100.0 -3.4028234663852886E+38 3.4028234663852886E+38 ECU_ADDRESS 0x4340C0 /end MEASUREMENT
/begin MEASUREMENT components.systemTest.drop "" UBYTE esdl_ident 1 100.0 0 1 ECU_ADDRESS 0x4340D0 BIT_MASK 0x1 /end MEASUREMENT
/begin MEASUREMENT components.systemTest.warningFunction_instance.sm "" UBYTE esdl_components_warningFunctionStatemachineStates 1 100.0 0 3 ECU_ADDRESS 0x434101 /end MEASUREMENT
/begin MEASUREMENT components.systemTest.warningFunction_instance.on "" UBYTE esdl_ident 1 100.0 0 1 ECU_ADDRESS 0x434100 BIT_MASK 0x1 /end MEASUREMENT
/begin MEASUREMENT components.systemTest.warningFunction_instance.counter "" SLONG esdl_ident 1 100.0 -2147483648 2147483647 ECU_ADDRESS 0x4340F4 /end MEASUREMENT
/begin MEASUREMENT components.systemTest.warningFunction_instance.dt_ "" FLOAT32_IEEE esdl_ident 1 100.0 -3.4028234663852886E+38 3.4028234663852886E+38 ECU_ADDRESS 0x4340F8 /end MEASUREMENT
/begin MEASUREMENT components.systemTest.warningFunction_instance.restTime "" FLOAT32_IEEE esdl_ident 1 100.0 -3.4028234663852886E+38 3.4028234663852886E+38 ECU_ADDRESS 0x4340FC /end MEASUREMENT
/begin MEASUREMENT components.systemTest.warningFunction_instance.base_rate "" FLOAT32_IEEE esdl_ident 1 100.0 -3.4028234663852886E+38 3.4028234663852886E+38 ECU_ADDRESS 0x4340EC /end MEASUREMENT
/begin MEASUREMENT components.systemTest.warningFunction_instance.break_rate "" FLOAT32_IEEE esdl_ident 1 100.0 -3.4028234663852886E+38 3.4028234663852886E+38 ECU_ADDRESS 0x4340F0 /end MEASUREMENT
/begin MEASUREMENT components.systemTest.warningFunction_in.sm "" UBYTE esdl_components_warningFunctionStatemachineStates 1 100.0 0 3 ECU_ADDRESS 0x4340E9 /end MEASUREMENT
/begin MEASUREMENT components.systemTest.warningFunction_in.on "" UBYTE esdl_ident 1 100.0 0 1 ECU_ADDRESS 0x4340E8 BIT_MASK 0x1 /end MEASUREMENT
/begin MEASUREMENT components.systemTest.warningFunction_in.counter "" SLONG esdl_ident 1 100.0 -2147483648 2147483647 ECU_ADDRESS 0x4340DC /end MEASUREMENT
/begin MEASUREMENT components.systemTest.warningFunction_in.dt_ "" FLOAT32_IEEE esdl_ident 1 100.0 -3.4028234663852886E+38 3.4028234663852886E+38 ECU_ADDRESS 0x4340E0 /end MEASUREMENT
/begin MEASUREMENT components.systemTest.warningFunction_in.restTime "" FLOAT32_IEEE esdl_ident 1 100.0 -3.4028234663852886E+38 3.4028234663852886E+38 ECU_ADDRESS 0x4340E4 /end MEASUREMENT
/begin MEASUREMENT components.systemTest.warningFunction_in.base_rate "" FLOAT32_IEEE esdl_ident 1 100.0 -3.4028234663852886E+38 3.4028234663852886E+38 ECU_ADDRESS 0x4340D4 /end MEASUREMENT
/begin MEASUREMENT components.systemTest.warningFunction_in.break_rate "" FLOAT32_IEEE esdl_ident 1 100.0 -3.4028234663852886E+38 3.4028234663852886E+38 ECU_ADDRESS 0x4340D8 /end MEASUREMENT
/begin MEASUREMENT components.randomNumberGenerator.X "" UWORD esdl_ident 1 100.0 0 300 ECU_ADDRESS 0x4340A0 /end MEASUREMENT
/begin COMPU_METHOD esdl_components_warningFunctionStatemachineStates "" TAB_VERB /* format */ "%12.4" /* unit */ "" /* compu_tab_ref */ COMPU_TAB_REF esdl_components_warningFunctionStatemachineStates_vtab /end COMPU_METHOD
/begin COMPU_VTAB esdl_components_warningFunctionStatemachineStates_vtab "" TAB_VERB /* number value pairs */ 4 0 "shortState" 1 "breakState" 2 "longState" 3 "mockState" /* default value */ DEFAULT_VALUE "Error" /end COMPU_VTAB
/begin COMPU_METHOD esdl_ident "" RAT_FUNC /* format */ "%12.4" /* unit */ "" /* coeffs */ COEFFS 0 1 0 0 0 1 /end COMPU_METHOD
/begin FUNCTION systemTest_PC ""
 /begin SUB_FUNCTION components.systemTest components.comparePressure components.DeltaTimeService components.detectDrop components.distanceCalc components.randomNumberGenerator /end SUB_FUNCTION
/end FUNCTION
/begin FUNCTION components.systemTest ""
 /begin LOC_MEASUREMENT components.systemTest.drop components.systemTest.dropPressure components.systemTest.dt_ components.systemTest.faktor components.systemTest.random components.systemTest.sound components.systemTest.t /end LOC_MEASUREMENT
 /begin SUB_FUNCTION components.systemTest.warningFunction_instance components.systemTest.warningFunction_in /end SUB_FUNCTION
/end FUNCTION
/begin FUNCTION components.systemTest.warningFunction_instance ""
 /begin LOC_MEASUREMENT components.systemTest.warningFunction_instance.base_rate components.systemTest.warningFunction_instance.break_rate components.systemTest.warningFunction_instance.counter components.systemTest.warningFunction_instance.dt_ components.systemTest.warningFunction_instance.on components.systemTest.warningFunction_instance.restTime components.systemTest.warningFunction_instance.sm /end LOC_MEASUREMENT
/end FUNCTION
/begin FUNCTION components.systemTest.warningFunction_in ""
 /begin LOC_MEASUREMENT components.systemTest.warningFunction_in.base_rate components.systemTest.warningFunction_in.break_rate components.systemTest.warningFunction_in.counter components.systemTest.warningFunction_in.dt_ components.systemTest.warningFunction_in.on components.systemTest.warningFunction_in.restTime components.systemTest.warningFunction_in.sm /end LOC_MEASUREMENT
/end FUNCTION
/begin FUNCTION components.comparePressure "" /end FUNCTION
/begin FUNCTION components.DeltaTimeService "" /end FUNCTION
/begin FUNCTION components.detectDrop "" /end FUNCTION
/begin FUNCTION components.distanceCalc "" /end FUNCTION
/begin FUNCTION components.randomNumberGenerator "" /begin LOC_MEASUREMENT components.randomNumberGenerator.X /end LOC_MEASUREMENT /end FUNCTION
/begin GROUP systemTest_PC "" ROOT
 /begin SUB_GROUP components.systemTest components.comparePressure components.DeltaTimeService components.detectDrop components.distanceCalc components.randomNumberGenerator /end SUB_GROUP
/end GROUP
/begin GROUP components.systemTest ""
 /begin REF_MEASUREMENT components.systemTest.drop components.systemTest.dropPressure components.systemTest.dt_ components.systemTest.faktor components.systemTest.random components.systemTest.sound components.systemTest.t /end REF_MEASUREMENT
 /begin SUB_GROUP components.systemTest.warningFunction_instance components.systemTest.warningFunction_in /end SUB_GROUP
/end GROUP
/begin GROUP components.systemTest.warningFunction_instance ""
 /begin REF_MEASUREMENT components.systemTest.warningFunction_instance.base_rate components.systemTest.warningFunction_instance.break_rate components.systemTest.warningFunction_instance.counter components.systemTest.warningFunction_instance.dt_ components.systemTest.warningFunction_instance.on components.systemTest.warningFunction_instance.restTime components.systemTest.warningFunction_instance.sm /end REF_MEASUREMENT
/end GROUP
/begin GROUP components.systemTest.warningFunction_in ""
 /begin REF_MEASUREMENT components.systemTest.warningFunction_in.base_rate components.systemTest.warningFunction_in.break_rate components.systemTest.warningFunction_in.counter components.systemTest.warningFunction_in.dt_ components.systemTest.warningFunction_in.on components.systemTest.warningFunction_in.restTime components.systemTest.warningFunction_in.sm /end REF_MEASUREMENT
/end GROUP
/begin GROUP components.comparePressure "" /end GROUP
/begin GROUP components.DeltaTimeService "" /end GROUP
/begin GROUP components.detectDrop "" /end GROUP
/begin GROUP components.distanceCalc "" /end GROUP
/begin GROUP components.randomNumberGenerator "" /begin REF_MEASUREMENT components.randomNumberGenerator.X /end REF_MEASUREMENT /end GROUP
/end MODULE
/end PROJECT
