ASAP2_VERSION 1 41
/begin PROJECT PC_PC "Generated by ETAS from Project PC_PC"
/begin HEADER "" VERSION "000" PROJECT_NO ASD /end HEADER
/begin MODULE PC_PC "Generated by ETAS ASCET7 from Project: PC_PC"
/begin IF_DATA E_TARGET
 /begin SOURCE "Task0" 3 /* period */ 10 QP_BLOB 1 /end SOURCE
 /begin TP_BLOB /* programm id */ 3816834427 /* target id */ 7 0 2 0 /end TP_BLOB
/end IF_DATA
/begin MOD_PAR "" VERSION "000" ADDR_EPK 0x0 EPK "" SUPPLIER "ETAS GmbH" CUSTOMER "xxx" CUSTOMER_NO "000" USER "xxx" PHONE_NO "000" ECU "PC" CPU_TYPE "PCx86" NO_OF_INTERFACES 1 /end MOD_PAR
/begin MOD_COMMON "Common definitions" BYTE_ORDER MSB_LAST ALIGNMENT_BYTE 1 ALIGNMENT_WORD 2 ALIGNMENT_LONG 4 ALIGNMENT_FLOAT32_IEEE 4 ALIGNMENT_FLOAT64_IEEE 8 /end MOD_COMMON
/begin CHARACTERISTIC components.Component.c "" VALUE /* ecu address */ 0x451022 /* record layout */ STANDARD_VALUE_U8 /* max diff value */ 0.0 esdl_ident 0 1 BIT_MASK 0x1 /end CHARACTERISTIC
/begin MEASUREMENT components.Component.change "" UBYTE esdl_ident 1 100.0 0 1 ECU_ADDRESS 0x451021 BIT_MASK 0x1 /end MEASUREMENT
/begin MEASUREMENT components.Component.sound "" UBYTE esdl_ident 1 100.0 0 1 ECU_ADDRESS 0x451020 BIT_MASK 0x1 /end MEASUREMENT
/begin MEASUREMENT components.Component.warningFunction_instance.sm "" UBYTE esdl_components_warningFunctionStatemachineStates 1 100.0 0 3 ECU_ADDRESS 0x434015 /end MEASUREMENT
/begin MEASUREMENT components.Component.warningFunction_instance.on "" UBYTE esdl_ident 1 100.0 0 1 ECU_ADDRESS 0x434014 BIT_MASK 0x1 /end MEASUREMENT
/begin MEASUREMENT components.Component.warningFunction_instance.counter "" SLONG esdl_ident 1 100.0 -2147483648 2147483647 ECU_ADDRESS 0x434008 /end MEASUREMENT
/begin MEASUREMENT components.Component.warningFunction_instance.dt_ "" FLOAT32_IEEE esdl_ident 1 100.0 -3.4028234663852886E+38 3.4028234663852886E+38 ECU_ADDRESS 0x43400C /end MEASUREMENT
/begin MEASUREMENT components.Component.warningFunction_instance.restTime "" FLOAT32_IEEE esdl_ident 1 100.0 -3.4028234663852886E+38 3.4028234663852886E+38 ECU_ADDRESS 0x434010 /end MEASUREMENT
/begin MEASUREMENT components.Component.warningFunction_instance.base_rate "" FLOAT32_IEEE esdl_ident 1 100.0 -3.4028234663852886E+38 3.4028234663852886E+38 ECU_ADDRESS 0x434000 /end MEASUREMENT
/begin MEASUREMENT components.Component.warningFunction_instance.break_rate "" FLOAT32_IEEE esdl_ident 1 100.0 -3.4028234663852886E+38 3.4028234663852886E+38 ECU_ADDRESS 0x434004 /end MEASUREMENT
/begin MEASUREMENT components.Component.warningFunction_instance_2.sm "" UBYTE esdl_components_warningFunctionStatemachineStates 1 100.0 0 3 ECU_ADDRESS 0x43402D /end MEASUREMENT
/begin MEASUREMENT components.Component.warningFunction_instance_2.on "" UBYTE esdl_ident 1 100.0 0 1 ECU_ADDRESS 0x43402C BIT_MASK 0x1 /end MEASUREMENT
/begin MEASUREMENT components.Component.warningFunction_instance_2.counter "" SLONG esdl_ident 1 100.0 -2147483648 2147483647 ECU_ADDRESS 0x434020 /end MEASUREMENT
/begin MEASUREMENT components.Component.warningFunction_instance_2.dt_ "" FLOAT32_IEEE esdl_ident 1 100.0 -3.4028234663852886E+38 3.4028234663852886E+38 ECU_ADDRESS 0x434024 /end MEASUREMENT
/begin MEASUREMENT components.Component.warningFunction_instance_2.restTime "" FLOAT32_IEEE esdl_ident 1 100.0 -3.4028234663852886E+38 3.4028234663852886E+38 ECU_ADDRESS 0x434028 /end MEASUREMENT
/begin MEASUREMENT components.Component.warningFunction_instance_2.base_rate "" FLOAT32_IEEE esdl_ident 1 100.0 -3.4028234663852886E+38 3.4028234663852886E+38 ECU_ADDRESS 0x434018 /end MEASUREMENT
/begin MEASUREMENT components.Component.warningFunction_instance_2.break_rate "" FLOAT32_IEEE esdl_ident 1 100.0 -3.4028234663852886E+38 3.4028234663852886E+38 ECU_ADDRESS 0x43401C /end MEASUREMENT
/begin MEASUREMENT components.Component.warningFunction_instance_3.sm "" UBYTE esdl_components_warningFunctionStatemachineStates 1 100.0 0 3 ECU_ADDRESS 0x434045 /end MEASUREMENT
/begin MEASUREMENT components.Component.warningFunction_instance_3.on "" UBYTE esdl_ident 1 100.0 0 1 ECU_ADDRESS 0x434044 BIT_MASK 0x1 /end MEASUREMENT
/begin MEASUREMENT components.Component.warningFunction_instance_3.counter "" SLONG esdl_ident 1 100.0 -2147483648 2147483647 ECU_ADDRESS 0x434038 /end MEASUREMENT
/begin MEASUREMENT components.Component.warningFunction_instance_3.dt_ "" FLOAT32_IEEE esdl_ident 1 100.0 -3.4028234663852886E+38 3.4028234663852886E+38 ECU_ADDRESS 0x43403C /end MEASUREMENT
/begin MEASUREMENT components.Component.warningFunction_instance_3.restTime "" FLOAT32_IEEE esdl_ident 1 100.0 -3.4028234663852886E+38 3.4028234663852886E+38 ECU_ADDRESS 0x434040 /end MEASUREMENT
/begin MEASUREMENT components.Component.warningFunction_instance_3.base_rate "" FLOAT32_IEEE esdl_ident 1 100.0 -3.4028234663852886E+38 3.4028234663852886E+38 ECU_ADDRESS 0x434030 /end MEASUREMENT
/begin MEASUREMENT components.Component.warningFunction_instance_3.break_rate "" FLOAT32_IEEE esdl_ident 1 100.0 -3.4028234663852886E+38 3.4028234663852886E+38 ECU_ADDRESS 0x434034 /end MEASUREMENT
/begin MEASUREMENT components.Component.warningFunction_instance_4.sm "" UBYTE esdl_components_warningFunctionStatemachineStates 1 100.0 0 3 ECU_ADDRESS 0x43405D /end MEASUREMENT
/begin MEASUREMENT components.Component.warningFunction_instance_4.on "" UBYTE esdl_ident 1 100.0 0 1 ECU_ADDRESS 0x43405C BIT_MASK 0x1 /end MEASUREMENT
/begin MEASUREMENT components.Component.warningFunction_instance_4.counter "" SLONG esdl_ident 1 100.0 -2147483648 2147483647 ECU_ADDRESS 0x434050 /end MEASUREMENT
/begin MEASUREMENT components.Component.warningFunction_instance_4.dt_ "" FLOAT32_IEEE esdl_ident 1 100.0 -3.4028234663852886E+38 3.4028234663852886E+38 ECU_ADDRESS 0x434054 /end MEASUREMENT
/begin MEASUREMENT components.Component.warningFunction_instance_4.restTime "" FLOAT32_IEEE esdl_ident 1 100.0 -3.4028234663852886E+38 3.4028234663852886E+38 ECU_ADDRESS 0x434058 /end MEASUREMENT
/begin MEASUREMENT components.Component.warningFunction_instance_4.base_rate "" FLOAT32_IEEE esdl_ident 1 100.0 -3.4028234663852886E+38 3.4028234663852886E+38 ECU_ADDRESS 0x434048 /end MEASUREMENT
/begin MEASUREMENT components.Component.warningFunction_instance_4.break_rate "" FLOAT32_IEEE esdl_ident 1 100.0 -3.4028234663852886E+38 3.4028234663852886E+38 ECU_ADDRESS 0x43404C /end MEASUREMENT
/begin COMPU_METHOD esdl_components_warningFunctionStatemachineStates "" TAB_VERB /* format */ "%12.4" /* unit */ "" /* compu_tab_ref */ COMPU_TAB_REF esdl_components_warningFunctionStatemachineStates_vtab /end COMPU_METHOD
/begin COMPU_VTAB esdl_components_warningFunctionStatemachineStates_vtab "" TAB_VERB /* number value pairs */ 4 0 "shortState" 1 "breakState" 2 "longState" 3 "mockState" /* default value */ DEFAULT_VALUE "Error" /end COMPU_VTAB
/begin COMPU_METHOD esdl_ident "" RAT_FUNC /* format */ "%12.4" /* unit */ "" /* coeffs */ COEFFS 0 1 0 0 0 1 /end COMPU_METHOD
/begin FUNCTION PC_PC "" /begin SUB_FUNCTION components.Component components.DeltaTimeService /end SUB_FUNCTION /end FUNCTION
/begin FUNCTION components.Component "" /begin DEF_CHARACTERISTIC components.Component.c /end DEF_CHARACTERISTIC /begin LOC_MEASUREMENT components.Component.change components.Component.sound /end LOC_MEASUREMENT
 /begin SUB_FUNCTION components.Component.warningFunction_instance components.Component.warningFunction_instance_2 components.Component.warningFunction_instance_3 components.Component.warningFunction_instance_4 /end SUB_FUNCTION
/end FUNCTION
/begin FUNCTION components.Component.warningFunction_instance ""
 /begin LOC_MEASUREMENT components.Component.warningFunction_instance.base_rate components.Component.warningFunction_instance.break_rate components.Component.warningFunction_instance.counter components.Component.warningFunction_instance.dt_ components.Component.warningFunction_instance.on components.Component.warningFunction_instance.restTime components.Component.warningFunction_instance.sm /end LOC_MEASUREMENT
/end FUNCTION
/begin FUNCTION components.Component.warningFunction_instance_2 ""
 /begin LOC_MEASUREMENT components.Component.warningFunction_instance_2.base_rate components.Component.warningFunction_instance_2.break_rate components.Component.warningFunction_instance_2.counter components.Component.warningFunction_instance_2.dt_ components.Component.warningFunction_instance_2.on components.Component.warningFunction_instance_2.restTime components.Component.warningFunction_instance_2.sm /end LOC_MEASUREMENT
/end FUNCTION
/begin FUNCTION components.Component.warningFunction_instance_3 ""
 /begin LOC_MEASUREMENT components.Component.warningFunction_instance_3.base_rate components.Component.warningFunction_instance_3.break_rate components.Component.warningFunction_instance_3.counter components.Component.warningFunction_instance_3.dt_ components.Component.warningFunction_instance_3.on components.Component.warningFunction_instance_3.restTime components.Component.warningFunction_instance_3.sm /end LOC_MEASUREMENT
/end FUNCTION
/begin FUNCTION components.Component.warningFunction_instance_4 ""
 /begin LOC_MEASUREMENT components.Component.warningFunction_instance_4.base_rate components.Component.warningFunction_instance_4.break_rate components.Component.warningFunction_instance_4.counter components.Component.warningFunction_instance_4.dt_ components.Component.warningFunction_instance_4.on components.Component.warningFunction_instance_4.restTime components.Component.warningFunction_instance_4.sm /end LOC_MEASUREMENT
/end FUNCTION
/begin FUNCTION components.DeltaTimeService "" /end FUNCTION
/begin RECORD_LAYOUT STANDARD_VALUE_U8 /* value */ FNC_VALUES 1 UBYTE COLUMN_DIR DIRECT /end RECORD_LAYOUT
/begin GROUP PC_PC "" ROOT /begin SUB_GROUP components.Component components.DeltaTimeService /end SUB_GROUP /end GROUP
/begin GROUP components.Component "" /begin REF_CHARACTERISTIC components.Component.c /end REF_CHARACTERISTIC /begin REF_MEASUREMENT components.Component.change components.Component.sound /end REF_MEASUREMENT
 /begin SUB_GROUP components.Component.warningFunction_instance components.Component.warningFunction_instance_2 components.Component.warningFunction_instance_3 components.Component.warningFunction_instance_4 /end SUB_GROUP
/end GROUP
/begin GROUP components.Component.warningFunction_instance ""
 /begin REF_MEASUREMENT components.Component.warningFunction_instance.base_rate components.Component.warningFunction_instance.break_rate components.Component.warningFunction_instance.counter components.Component.warningFunction_instance.dt_ components.Component.warningFunction_instance.on components.Component.warningFunction_instance.restTime components.Component.warningFunction_instance.sm /end REF_MEASUREMENT
/end GROUP
/begin GROUP components.Component.warningFunction_instance_2 ""
 /begin REF_MEASUREMENT components.Component.warningFunction_instance_2.base_rate components.Component.warningFunction_instance_2.break_rate components.Component.warningFunction_instance_2.counter components.Component.warningFunction_instance_2.dt_ components.Component.warningFunction_instance_2.on components.Component.warningFunction_instance_2.restTime components.Component.warningFunction_instance_2.sm /end REF_MEASUREMENT
/end GROUP
/begin GROUP components.Component.warningFunction_instance_3 ""
 /begin REF_MEASUREMENT components.Component.warningFunction_instance_3.base_rate components.Component.warningFunction_instance_3.break_rate components.Component.warningFunction_instance_3.counter components.Component.warningFunction_instance_3.dt_ components.Component.warningFunction_instance_3.on components.Component.warningFunction_instance_3.restTime components.Component.warningFunction_instance_3.sm /end REF_MEASUREMENT
/end GROUP
/begin GROUP components.Component.warningFunction_instance_4 ""
 /begin REF_MEASUREMENT components.Component.warningFunction_instance_4.base_rate components.Component.warningFunction_instance_4.break_rate components.Component.warningFunction_instance_4.counter components.Component.warningFunction_instance_4.dt_ components.Component.warningFunction_instance_4.on components.Component.warningFunction_instance_4.restTime components.Component.warningFunction_instance_4.sm /end REF_MEASUREMENT
/end GROUP
/begin GROUP components.DeltaTimeService "" /end GROUP
/end MODULE
/end PROJECT
