ASAP2_VERSION 1 41
/begin PROJECT randomtest_PC "Generated by ETAS from Project randomtest_PC"
/begin HEADER "" VERSION "000" PROJECT_NO ASD /end HEADER
/begin MODULE randomtest_PC "Generated by ETAS ASCET7 from Project: randomtest_PC"
/begin IF_DATA E_TARGET
 /begin SOURCE "Task0" /* type */ 3 /* period */ 10 QP_BLOB 1 /end SOURCE
 /begin TP_BLOB /* programm id */ 3816834427 /* target id */ 7 0 2 0 /end TP_BLOB
/end IF_DATA
/begin MOD_PAR "" VERSION "000" ADDR_EPK 0x0 EPK "" SUPPLIER "ETAS GmbH" CUSTOMER "xxx" CUSTOMER_NO "000" USER "xxx" PHONE_NO "000" ECU "PC" CPU_TYPE "PCx86" NO_OF_INTERFACES 1 /end MOD_PAR
/begin MOD_COMMON "Common definitions" BYTE_ORDER MSB_LAST ALIGNMENT_BYTE 1 ALIGNMENT_WORD 2 ALIGNMENT_LONG 4 ALIGNMENT_FLOAT32_IEEE 4 ALIGNMENT_FLOAT64_IEEE 8 /end MOD_COMMON
/begin MEASUREMENT components.test_.random "" SLONG esdl_ident 1 100.0 -2147483648 2147483647 ECU_ADDRESS 0x451020 /end MEASUREMENT
/begin MEASUREMENT components.test.X "" UWORD esdl_ident 1 100.0 0 300 ECU_ADDRESS 0x434000 /end MEASUREMENT
/begin MEASUREMENT components.test.zwischen "" UWORD esdl_ident 1 100.0 0 300 ECU_ADDRESS 0x43400A /end MEASUREMENT
/begin MEASUREMENT components.test.sum "" UWORD esdl_ident 1 100.0 0 300 ECU_ADDRESS 0x434002 /end MEASUREMENT
/begin MEASUREMENT components.test.sum2 "" UWORD esdl_ident 1 100.0 0 300 ECU_ADDRESS 0x434004 /end MEASUREMENT
/begin MEASUREMENT components.test.sum3 "" UWORD esdl_ident 1 100.0 0 300 ECU_ADDRESS 0x434006 /end MEASUREMENT
/begin MEASUREMENT components.test.v "" UWORD esdl_ident 1 100.0 0 300 ECU_ADDRESS 0x434008 /end MEASUREMENT
/begin COMPU_METHOD esdl_ident "" /* type */ RAT_FUNC /* format */ "%12.4" /* unit */ "" /* coeffs */ COEFFS 0 1 0 0 0 1 /end COMPU_METHOD
/begin FUNCTION randomtest_PC "" /begin SUB_FUNCTION components.test_ components.test /end SUB_FUNCTION /end FUNCTION
/begin FUNCTION components.test_ "" /begin LOC_MEASUREMENT components.test_.random /end LOC_MEASUREMENT /end FUNCTION
/begin FUNCTION components.test ""
 /begin LOC_MEASUREMENT components.test.X components.test.sum components.test.sum2 components.test.sum3 components.test.v components.test.zwischen /end LOC_MEASUREMENT
/end FUNCTION
/begin GROUP randomtest_PC "" ROOT /begin SUB_GROUP components.test_ components.test /end SUB_GROUP /end GROUP
/begin GROUP components.test_ "" /begin REF_MEASUREMENT components.test_.random /end REF_MEASUREMENT /end GROUP
/begin GROUP components.test ""
 /begin REF_MEASUREMENT components.test.X components.test.sum components.test.sum2 components.test.sum3 components.test.v components.test.zwischen /end REF_MEASUREMENT
/end GROUP
/end MODULE
/end PROJECT
